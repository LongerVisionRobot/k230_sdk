## Kconfig.toolchain
```kconfig
menu "toolchain configurations"
config TOOLCHAIN_PREFIX_RTT
        string "rt-smart toolchain prefix"
        default "riscv64-unknown-linux-musl-"

config TOOLCHAIN_PATH_RTT
        string "rt-smart toolchain path"
        default "/opt/toolchain/Xuantie-900-gcc-linux-musl64-x86_64/bin"

config TOOLCHAIN_PREFIX_LINUX
        string "linux toolchain prefix"
        default "riscv64-unknown-linux-gnu-"

config TOOLCHAIN_PATH_LINUX
        string "linux toolchain path"
        default "/opt/toolchain/Xuantie-900-gcc-linux-glibc-x86_64/bin"

endmenu
```
